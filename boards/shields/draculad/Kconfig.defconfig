## boards/shields/draculad/Kconfig.defconfig
```kconfig
if SHIELD_DRACULAD_LEFT || SHIELD_DRACULAD_RIGHT

config ZMK_KEYBOARD_NAME
    default "DracuLad"

endif
```

## boards/shields/draculad/Kconfig.shield
```kconfig
config SHIELD_DRACULAD_LEFT
    def_bool $(shields_list_contains,draculad_left)

config SHIELD_DRACULAD_RIGHT
    def_bool $(shields_list_contains,draculad_right)
```

## config/west.yml
```yaml
manifest:
    remotes:
      - name: zmkfirmware
        url-base: https://github.com/zmkfirmware
      - name: ntimesgurgel
        url-base: https://github.com/ntimesgurgel
    projects:
      - name: zmk
        remote: zmkfirmware
        revision: main   
        import: app/west.yml
    
      - name: zmk-config
        remote: ntimesgurgel
        revision: main
    self:
      path: config
```
